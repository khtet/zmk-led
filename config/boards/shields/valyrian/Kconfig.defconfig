## config/boards/shields/valyrian/Kconfig.defconfig
```kconfig
if SHIELD_VALYRIAN_LEFT

# Name must be less than 16 characters long!
config VALYRIAN
    default "valyrian"

config ZMK_SPLIT_ROLE_CENTRAL
    default y

endif

if SHIELD_VALYRIAN_LEFT || SHIELD_VALYRIAN_RIGHT

config ZMK_SPLIT
    default y

endif
```

## config/boards/shields/valyrian/Kconfig.shield
```kconfig
# No whitespace after the comma or in your part name!
config SHIELD_VALYRIAN_LEFT
    def_bool $(shields_list_contains,valyrian_left)

# No whitespace after the comma or in your part name!
config SHIELD_VALYRIAN_RIGHT
    def_bool $(shields_list_contains,valyrian_right)
```
